## app_samples/z_nrf52_dongle/build/Kconfig/soc/Kconfig.soc
```kconfig
# Load SoC Kconfig descriptions.
osource "/Users/pdlsurya/ZephyrSDK/zephyr/soc/xlnx/zynqmp/Kconfig.soc"
osource "/Users/pdlsurya/ZephyrSDK/zephyr/soc/xlnx/zynq7000/Kconfig.soc"
osource "/Users/pdlsurya/ZephyrSDK/zephyr/soc/xen/Kconfig.soc"
osource "/Users/pdlsurya/ZephyrSDK/zephyr/soc/ti/simplelink/Kconfig.soc"
osource "/Users/pdlsurya/ZephyrSDK/zephyr/soc/ti/lm3s6965/Kconfig.soc"
osource "/Users/pdlsurya/ZephyrSDK/zephyr/soc/ti/k3/Kconfig.soc"
osource "/Users/pdlsurya/ZephyrSDK/zephyr/soc/telink/tlsr/Kconfig.soc"
osource "/Users/pdlsurya/ZephyrSDK/zephyr/soc/starfive/jh71xx/Kconfig.soc"
osource "/Users/pdlsurya/ZephyrSDK/zephyr/soc/st/stm32/Kconfig.soc"
osource "/Users/pdlsurya/ZephyrSDK/zephyr/soc/snps/qemu_arc/Kconfig.soc"
osource "/Users/pdlsurya/ZephyrSDK/zephyr/soc/snps/nsim/Kconfig.soc"
osource "/Users/pdlsurya/ZephyrSDK/zephyr/soc/snps/hsdk4xd/Kconfig.soc"
osource "/Users/pdlsurya/ZephyrSDK/zephyr/soc/snps/hsdk/Kconfig.soc"
osource "/Users/pdlsurya/ZephyrSDK/zephyr/soc/snps/emsk/Kconfig.soc"
osource "/Users/pdlsurya/ZephyrSDK/zephyr/soc/snps/emsdp/Kconfig.soc"
osource "/Users/pdlsurya/ZephyrSDK/zephyr/soc/snps/arc_iot/Kconfig.soc"
osource "/Users/pdlsurya/ZephyrSDK/zephyr/soc/silabs/Kconfig.soc"
osource "/Users/pdlsurya/ZephyrSDK/zephyr/soc/sifive/sifive_freedom/Kconfig.soc"
osource "/Users/pdlsurya/ZephyrSDK/zephyr/soc/rockchip/Kconfig.soc"
osource "/Users/pdlsurya/ZephyrSDK/zephyr/soc/renode/riscv_virtual/Kconfig.soc"
osource "/Users/pdlsurya/ZephyrSDK/zephyr/soc/renesas/smartbond/Kconfig.soc"
osource "/Users/pdlsurya/ZephyrSDK/zephyr/soc/renesas/rzt2m/Kconfig.soc"
osource "/Users/pdlsurya/ZephyrSDK/zephyr/soc/renesas/rcar/Kconfig.soc"
osource "/Users/pdlsurya/ZephyrSDK/zephyr/soc/renesas/ra/Kconfig.soc"
osource "/Users/pdlsurya/ZephyrSDK/zephyr/soc/raspberrypi/Kconfig.soc"
osource "/Users/pdlsurya/ZephyrSDK/zephyr/soc/quicklogic/eos_s3/Kconfig.soc"
osource "/Users/pdlsurya/ZephyrSDK/zephyr/soc/qemu/virt_riscv/Kconfig.soc"
osource "/Users/pdlsurya/ZephyrSDK/zephyr/soc/qemu/malta/Kconfig.soc"
osource "/Users/pdlsurya/ZephyrSDK/zephyr/soc/openisa/rv32m1/Kconfig.soc"
osource "/Users/pdlsurya/ZephyrSDK/zephyr/soc/nxp/s32/Kconfig.soc"
osource "/Users/pdlsurya/ZephyrSDK/zephyr/soc/nxp/rw/Kconfig.soc"
osource "/Users/pdlsurya/ZephyrSDK/zephyr/soc/nxp/mcx/Kconfig.soc"
osource "/Users/pdlsurya/ZephyrSDK/zephyr/soc/nxp/lpc/Kconfig.soc"
osource "/Users/pdlsurya/ZephyrSDK/zephyr/soc/nxp/layerscape/Kconfig.soc"
osource "/Users/pdlsurya/ZephyrSDK/zephyr/soc/nxp/kinetis/Kconfig.soc"
osource "/Users/pdlsurya/ZephyrSDK/zephyr/soc/nxp/imxrt/Kconfig.soc"
osource "/Users/pdlsurya/ZephyrSDK/zephyr/soc/nxp/imx/Kconfig.soc"
osource "/Users/pdlsurya/ZephyrSDK/zephyr/soc/nuvoton/numicro/Kconfig.soc"
osource "/Users/pdlsurya/ZephyrSDK/zephyr/soc/nuvoton/numaker/Kconfig.soc"
osource "/Users/pdlsurya/ZephyrSDK/zephyr/soc/nuvoton/npcx/Kconfig.soc"
osource "/Users/pdlsurya/ZephyrSDK/zephyr/soc/nordic/Kconfig.soc"
osource "/Users/pdlsurya/ZephyrSDK/zephyr/soc/neorv32/Kconfig.soc"
osource "/Users/pdlsurya/ZephyrSDK/zephyr/soc/native/inf_clock/Kconfig.soc"
osource "/Users/pdlsurya/ZephyrSDK/zephyr/soc/microchip/miv/Kconfig.soc"
osource "/Users/pdlsurya/ZephyrSDK/zephyr/soc/microchip/mec/Kconfig.soc"
osource "/Users/pdlsurya/ZephyrSDK/zephyr/soc/lowrisc/opentitan/Kconfig.soc"
osource "/Users/pdlsurya/ZephyrSDK/zephyr/soc/litex/litex_vexriscv/Kconfig.soc"
osource "/Users/pdlsurya/ZephyrSDK/zephyr/soc/ite/ec/Kconfig.soc"
osource "/Users/pdlsurya/ZephyrSDK/zephyr/soc/intel/raptor_lake/Kconfig.soc"
osource "/Users/pdlsurya/ZephyrSDK/zephyr/soc/intel/lakemont/Kconfig.soc"
osource "/Users/pdlsurya/ZephyrSDK/zephyr/soc/intel/intel_socfpga_std/Kconfig.soc"
osource "/Users/pdlsurya/ZephyrSDK/zephyr/soc/intel/intel_socfpga/Kconfig.soc"
osource "/Users/pdlsurya/ZephyrSDK/zephyr/soc/intel/intel_niosv/Kconfig.soc"
osource "/Users/pdlsurya/ZephyrSDK/zephyr/soc/intel/intel_ish/Kconfig.soc"
osource "/Users/pdlsurya/ZephyrSDK/zephyr/soc/intel/intel_adsp/Kconfig.soc"
osource "/Users/pdlsurya/ZephyrSDK/zephyr/soc/intel/elkhart_lake/Kconfig.soc"
osource "/Users/pdlsurya/ZephyrSDK/zephyr/soc/intel/atom/Kconfig.soc"
osource "/Users/pdlsurya/ZephyrSDK/zephyr/soc/intel/apollo_lake/Kconfig.soc"
osource "/Users/pdlsurya/ZephyrSDK/zephyr/soc/intel/alder_lake/Kconfig.soc"
osource "/Users/pdlsurya/ZephyrSDK/zephyr/soc/infineon/xmc/Kconfig.soc"
osource "/Users/pdlsurya/ZephyrSDK/zephyr/soc/gd/gd32/Kconfig.soc"
osource "/Users/pdlsurya/ZephyrSDK/zephyr/soc/gaisler/leon3/Kconfig.soc"
osource "/Users/pdlsurya/ZephyrSDK/zephyr/soc/gaisler/gr716a/Kconfig.soc"
osource "/Users/pdlsurya/ZephyrSDK/zephyr/soc/espressif/Kconfig.soc"
osource "/Users/pdlsurya/ZephyrSDK/zephyr/soc/ene/kb1200/Kconfig.soc"
osource "/Users/pdlsurya/ZephyrSDK/zephyr/soc/efinix/sapphire/Kconfig.soc"
osource "/Users/pdlsurya/ZephyrSDK/zephyr/soc/cypress/Kconfig.soc"
osource "/Users/pdlsurya/ZephyrSDK/zephyr/soc/cdns/xtensa_sample_controller/Kconfig.soc"
osource "/Users/pdlsurya/ZephyrSDK/zephyr/soc/cdns/dc233c/Kconfig.soc"
osource "/Users/pdlsurya/ZephyrSDK/zephyr/soc/brcm/bcmvk/Kconfig.soc"
osource "/Users/pdlsurya/ZephyrSDK/zephyr/soc/brcm/bcm2711/Kconfig.soc"
osource "/Users/pdlsurya/ZephyrSDK/zephyr/soc/atmel/sam0/Kconfig.soc"
osource "/Users/pdlsurya/ZephyrSDK/zephyr/soc/atmel/sam/Kconfig.soc"
osource "/Users/pdlsurya/ZephyrSDK/zephyr/soc/aspeed/Kconfig.soc"
osource "/Users/pdlsurya/ZephyrSDK/zephyr/soc/arm/Kconfig.soc"
osource "/Users/pdlsurya/ZephyrSDK/zephyr/soc/arm/beetle/Kconfig.soc"
osource "/Users/pdlsurya/ZephyrSDK/zephyr/soc/andestech/Kconfig.soc"
osource "/Users/pdlsurya/ZephyrSDK/zephyr/soc/ambiq/Kconfig.soc"
osource "/Users/pdlsurya/ZephyrSDK/zephyr/soc/altr/zephyr_nios2f/Kconfig.soc"
osource "/Users/pdlsurya/ZephyrSDK/zephyr/soc/altr/qemu_nios2/Kconfig.soc"
```

## drivers/SD_drv/Kconfig
```kconfig
# Copyright (c) 2023 Surya Poudel
# SPDX-License-Identifier: Apache-2.0

config SD_DRV
	bool "SD card driver on SPI bus"
	default n
        select SPI
	help
	 Enable SD card driver.
```

## drivers/nrf24_drv/Kconfig
```kconfig
# Copyright (c) 2023 Surya Poudel
# SPDX-License-Identifier: Apache-2.0

config NRF24_DRV
	bool "NRF24 wireless module driver"
	default n
	select SPI
	help
	 Enable NRF24 driver module.
```

## drivers/sh1106_drv/Kconfig
```kconfig
# SH1106 display controller configuration options

# Copyright (c) 2023 Surya Poudel
# SPDX-License-Identifier: Apache-2.0

config OLED_SH1106
	bool "SH1106 display controller driver"
	default n
	depends on DT_HAS_SINOWEALTH_SH1106_CUSTOM_ENABLED
	select I2C
	help
	  Enable driver for SH1106 display controller driver.
```

## dts/bindings/display/sinowealth,sh1106-custom.yaml
```yaml
# Copyright (c) 2023, Surya Poduel
# SPDX-License-Identifier: Apache-2.0

description: SH1106 128x64 dot-matrix display controller on I2C bus

compatible: "sinowealth,sh1106-custom"

include: [ i2c-device.yaml ]
```

## dts/bindings/nrf24/nordic,nrf24.yaml
```yaml
# Copyright (c) 2023, Surya Poudel
# SPDX-License-Identifier: Apache-2.0

description: "NRF24 2.4GHz wireless module on SPI bus"

compatible: "nordic,nrf24"

include: [ spi-device.yaml ]

properties:
  ce-gpios:
    type: phandle-array
    required: true
    description: "Chip Enable(CE) gpio pin"
```

## subsys/SdFat/Kconfig
```kconfig
# Copyright (c) 2023 Surya Poudel
# SPDX-License-Identifier: Apache-2.0

config SD_FAT
	bool "FAT file system lib for SD card"
	default n
	help
	 Enable SD-FAT library.
```

## subsys/nrf24_ble/Kconfig
```kconfig
# Copyright (c) 2023 Surya Poudel
# SPDX-License-Identifier: Apache-2.0

config NRF24_BLE
	bool "BLE advertising module  on NRF24 wireless module"
	default n
	depends on NRF24_DRV
	help
	 Enable NRF24 BLE Advertising module
```

## subsys/sh1106_gfx/Kconfig
```kconfig
# Frame buffer configuration options

# Copyright (c) 2023 Surya Poudel
# SPDX-License-Identifier: Apache-2.0

config SH1106_GFX
	bool "SH1106 Graphics Library"
	default n
	depends on OLED_SH1106
	help
	 Enable SH1106 Graphics Library
```
