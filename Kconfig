## app_samples/z_nrf52_dongle/build/Kconfig/soc/Kconfig
```kconfig
# Load Zephyr SoC Kconfig descriptions.
osource "/Users/pdlsurya/ZephyrSDK/zephyr/soc/xlnx/zynqmp/Kconfig"
osource "/Users/pdlsurya/ZephyrSDK/zephyr/soc/xlnx/zynq7000/Kconfig"
osource "/Users/pdlsurya/ZephyrSDK/zephyr/soc/xen/Kconfig"
osource "/Users/pdlsurya/ZephyrSDK/zephyr/soc/ti/simplelink/Kconfig"
osource "/Users/pdlsurya/ZephyrSDK/zephyr/soc/ti/lm3s6965/Kconfig"
osource "/Users/pdlsurya/ZephyrSDK/zephyr/soc/ti/k3/Kconfig"
osource "/Users/pdlsurya/ZephyrSDK/zephyr/soc/telink/tlsr/Kconfig"
osource "/Users/pdlsurya/ZephyrSDK/zephyr/soc/starfive/jh71xx/Kconfig"
osource "/Users/pdlsurya/ZephyrSDK/zephyr/soc/st/stm32/Kconfig"
osource "/Users/pdlsurya/ZephyrSDK/zephyr/soc/snps/qemu_arc/Kconfig"
osource "/Users/pdlsurya/ZephyrSDK/zephyr/soc/snps/nsim/Kconfig"
osource "/Users/pdlsurya/ZephyrSDK/zephyr/soc/snps/hsdk4xd/Kconfig"
osource "/Users/pdlsurya/ZephyrSDK/zephyr/soc/snps/hsdk/Kconfig"
osource "/Users/pdlsurya/ZephyrSDK/zephyr/soc/snps/emsk/Kconfig"
osource "/Users/pdlsurya/ZephyrSDK/zephyr/soc/snps/emsdp/Kconfig"
osource "/Users/pdlsurya/ZephyrSDK/zephyr/soc/snps/arc_iot/Kconfig"
osource "/Users/pdlsurya/ZephyrSDK/zephyr/soc/silabs/Kconfig"
osource "/Users/pdlsurya/ZephyrSDK/zephyr/soc/sifive/sifive_freedom/Kconfig"
osource "/Users/pdlsurya/ZephyrSDK/zephyr/soc/rockchip/Kconfig"
osource "/Users/pdlsurya/ZephyrSDK/zephyr/soc/renode/riscv_virtual/Kconfig"
osource "/Users/pdlsurya/ZephyrSDK/zephyr/soc/renesas/smartbond/Kconfig"
osource "/Users/pdlsurya/ZephyrSDK/zephyr/soc/renesas/rzt2m/Kconfig"
osource "/Users/pdlsurya/ZephyrSDK/zephyr/soc/renesas/rcar/Kconfig"
osource "/Users/pdlsurya/ZephyrSDK/zephyr/soc/renesas/ra/Kconfig"
osource "/Users/pdlsurya/ZephyrSDK/zephyr/soc/raspberrypi/Kconfig"
osource "/Users/pdlsurya/ZephyrSDK/zephyr/soc/quicklogic/eos_s3/Kconfig"
osource "/Users/pdlsurya/ZephyrSDK/zephyr/soc/qemu/virt_riscv/Kconfig"
osource "/Users/pdlsurya/ZephyrSDK/zephyr/soc/qemu/malta/Kconfig"
osource "/Users/pdlsurya/ZephyrSDK/zephyr/soc/openisa/rv32m1/Kconfig"
osource "/Users/pdlsurya/ZephyrSDK/zephyr/soc/nxp/s32/Kconfig"
osource "/Users/pdlsurya/ZephyrSDK/zephyr/soc/nxp/rw/Kconfig"
osource "/Users/pdlsurya/ZephyrSDK/zephyr/soc/nxp/mcx/Kconfig"
osource "/Users/pdlsurya/ZephyrSDK/zephyr/soc/nxp/lpc/Kconfig"
osource "/Users/pdlsurya/ZephyrSDK/zephyr/soc/nxp/layerscape/Kconfig"
osource "/Users/pdlsurya/ZephyrSDK/zephyr/soc/nxp/kinetis/Kconfig"
osource "/Users/pdlsurya/ZephyrSDK/zephyr/soc/nxp/imxrt/Kconfig"
osource "/Users/pdlsurya/ZephyrSDK/zephyr/soc/nxp/imx/Kconfig"
osource "/Users/pdlsurya/ZephyrSDK/zephyr/soc/nuvoton/numicro/Kconfig"
osource "/Users/pdlsurya/ZephyrSDK/zephyr/soc/nuvoton/numaker/Kconfig"
osource "/Users/pdlsurya/ZephyrSDK/zephyr/soc/nuvoton/npcx/Kconfig"
osource "/Users/pdlsurya/ZephyrSDK/zephyr/soc/nordic/Kconfig"
osource "/Users/pdlsurya/ZephyrSDK/zephyr/soc/neorv32/Kconfig"
osource "/Users/pdlsurya/ZephyrSDK/zephyr/soc/native/inf_clock/Kconfig"
osource "/Users/pdlsurya/ZephyrSDK/zephyr/soc/microchip/miv/Kconfig"
osource "/Users/pdlsurya/ZephyrSDK/zephyr/soc/microchip/mec/Kconfig"
osource "/Users/pdlsurya/ZephyrSDK/zephyr/soc/lowrisc/opentitan/Kconfig"
osource "/Users/pdlsurya/ZephyrSDK/zephyr/soc/litex/litex_vexriscv/Kconfig"
osource "/Users/pdlsurya/ZephyrSDK/zephyr/soc/ite/ec/Kconfig"
osource "/Users/pdlsurya/ZephyrSDK/zephyr/soc/intel/raptor_lake/Kconfig"
osource "/Users/pdlsurya/ZephyrSDK/zephyr/soc/intel/lakemont/Kconfig"
osource "/Users/pdlsurya/ZephyrSDK/zephyr/soc/intel/intel_socfpga_std/Kconfig"
osource "/Users/pdlsurya/ZephyrSDK/zephyr/soc/intel/intel_socfpga/Kconfig"
osource "/Users/pdlsurya/ZephyrSDK/zephyr/soc/intel/intel_niosv/Kconfig"
osource "/Users/pdlsurya/ZephyrSDK/zephyr/soc/intel/intel_ish/Kconfig"
osource "/Users/pdlsurya/ZephyrSDK/zephyr/soc/intel/intel_adsp/Kconfig"
osource "/Users/pdlsurya/ZephyrSDK/zephyr/soc/intel/elkhart_lake/Kconfig"
osource "/Users/pdlsurya/ZephyrSDK/zephyr/soc/intel/atom/Kconfig"
osource "/Users/pdlsurya/ZephyrSDK/zephyr/soc/intel/apollo_lake/Kconfig"
osource "/Users/pdlsurya/ZephyrSDK/zephyr/soc/intel/alder_lake/Kconfig"
osource "/Users/pdlsurya/ZephyrSDK/zephyr/soc/infineon/xmc/Kconfig"
osource "/Users/pdlsurya/ZephyrSDK/zephyr/soc/gd/gd32/Kconfig"
osource "/Users/pdlsurya/ZephyrSDK/zephyr/soc/gaisler/leon3/Kconfig"
osource "/Users/pdlsurya/ZephyrSDK/zephyr/soc/gaisler/gr716a/Kconfig"
osource "/Users/pdlsurya/ZephyrSDK/zephyr/soc/espressif/Kconfig"
osource "/Users/pdlsurya/ZephyrSDK/zephyr/soc/ene/kb1200/Kconfig"
osource "/Users/pdlsurya/ZephyrSDK/zephyr/soc/efinix/sapphire/Kconfig"
osource "/Users/pdlsurya/ZephyrSDK/zephyr/soc/cypress/Kconfig"
osource "/Users/pdlsurya/ZephyrSDK/zephyr/soc/cdns/xtensa_sample_controller/Kconfig"
osource "/Users/pdlsurya/ZephyrSDK/zephyr/soc/cdns/dc233c/Kconfig"
osource "/Users/pdlsurya/ZephyrSDK/zephyr/soc/brcm/bcmvk/Kconfig"
osource "/Users/pdlsurya/ZephyrSDK/zephyr/soc/brcm/bcm2711/Kconfig"
osource "/Users/pdlsurya/ZephyrSDK/zephyr/soc/atmel/sam0/Kconfig"
osource "/Users/pdlsurya/ZephyrSDK/zephyr/soc/atmel/sam/Kconfig"
osource "/Users/pdlsurya/ZephyrSDK/zephyr/soc/aspeed/Kconfig"
osource "/Users/pdlsurya/ZephyrSDK/zephyr/soc/arm/Kconfig"
osource "/Users/pdlsurya/ZephyrSDK/zephyr/soc/arm/beetle/Kconfig"
osource "/Users/pdlsurya/ZephyrSDK/zephyr/soc/andestech/Kconfig"
osource "/Users/pdlsurya/ZephyrSDK/zephyr/soc/ambiq/Kconfig"
osource "/Users/pdlsurya/ZephyrSDK/zephyr/soc/altr/zephyr_nios2f/Kconfig"
osource "/Users/pdlsurya/ZephyrSDK/zephyr/soc/altr/qemu_nios2/Kconfig"
```

## app_samples/z_nrf52_dongle/build/Kconfig/soc/Kconfig.defconfig
```kconfig
# Load Zephyr SoC Kconfig defconfig.
osource "/Users/pdlsurya/ZephyrSDK/zephyr/soc/xlnx/zynqmp/Kconfig.defconfig"
osource "/Users/pdlsurya/ZephyrSDK/zephyr/soc/xlnx/zynq7000/Kconfig.defconfig"
osource "/Users/pdlsurya/ZephyrSDK/zephyr/soc/xen/Kconfig.defconfig"
osource "/Users/pdlsurya/ZephyrSDK/zephyr/soc/ti/simplelink/Kconfig.defconfig"
osource "/Users/pdlsurya/ZephyrSDK/zephyr/soc/ti/lm3s6965/Kconfig.defconfig"
osource "/Users/pdlsurya/ZephyrSDK/zephyr/soc/ti/k3/Kconfig.defconfig"
osource "/Users/pdlsurya/ZephyrSDK/zephyr/soc/telink/tlsr/Kconfig.defconfig"
osource "/Users/pdlsurya/ZephyrSDK/zephyr/soc/starfive/jh71xx/Kconfig.defconfig"
osource "/Users/pdlsurya/ZephyrSDK/zephyr/soc/st/stm32/Kconfig.defconfig"
osource "/Users/pdlsurya/ZephyrSDK/zephyr/soc/snps/qemu_arc/Kconfig.defconfig"
osource "/Users/pdlsurya/ZephyrSDK/zephyr/soc/snps/nsim/Kconfig.defconfig"
osource "/Users/pdlsurya/ZephyrSDK/zephyr/soc/snps/hsdk4xd/Kconfig.defconfig"
osource "/Users/pdlsurya/ZephyrSDK/zephyr/soc/snps/hsdk/Kconfig.defconfig"
osource "/Users/pdlsurya/ZephyrSDK/zephyr/soc/snps/emsk/Kconfig.defconfig"
osource "/Users/pdlsurya/ZephyrSDK/zephyr/soc/snps/emsdp/Kconfig.defconfig"
osource "/Users/pdlsurya/ZephyrSDK/zephyr/soc/snps/arc_iot/Kconfig.defconfig"
osource "/Users/pdlsurya/ZephyrSDK/zephyr/soc/silabs/Kconfig.defconfig"
osource "/Users/pdlsurya/ZephyrSDK/zephyr/soc/sifive/sifive_freedom/Kconfig.defconfig"
osource "/Users/pdlsurya/ZephyrSDK/zephyr/soc/rockchip/Kconfig.defconfig"
osource "/Users/pdlsurya/ZephyrSDK/zephyr/soc/renode/riscv_virtual/Kconfig.defconfig"
osource "/Users/pdlsurya/ZephyrSDK/zephyr/soc/renesas/smartbond/Kconfig.defconfig"
osource "/Users/pdlsurya/ZephyrSDK/zephyr/soc/renesas/rzt2m/Kconfig.defconfig"
osource "/Users/pdlsurya/ZephyrSDK/zephyr/soc/renesas/rcar/Kconfig.defconfig"
osource "/Users/pdlsurya/ZephyrSDK/zephyr/soc/renesas/ra/Kconfig.defconfig"
osource "/Users/pdlsurya/ZephyrSDK/zephyr/soc/raspberrypi/Kconfig.defconfig"
osource "/Users/pdlsurya/ZephyrSDK/zephyr/soc/quicklogic/eos_s3/Kconfig.defconfig"
osource "/Users/pdlsurya/ZephyrSDK/zephyr/soc/qemu/virt_riscv/Kconfig.defconfig"
osource "/Users/pdlsurya/ZephyrSDK/zephyr/soc/qemu/malta/Kconfig.defconfig"
osource "/Users/pdlsurya/ZephyrSDK/zephyr/soc/openisa/rv32m1/Kconfig.defconfig"
osource "/Users/pdlsurya/ZephyrSDK/zephyr/soc/nxp/s32/Kconfig.defconfig"
osource "/Users/pdlsurya/ZephyrSDK/zephyr/soc/nxp/rw/Kconfig.defconfig"
osource "/Users/pdlsurya/ZephyrSDK/zephyr/soc/nxp/mcx/Kconfig.defconfig"
osource "/Users/pdlsurya/ZephyrSDK/zephyr/soc/nxp/lpc/Kconfig.defconfig"
osource "/Users/pdlsurya/ZephyrSDK/zephyr/soc/nxp/layerscape/Kconfig.defconfig"
osource "/Users/pdlsurya/ZephyrSDK/zephyr/soc/nxp/kinetis/Kconfig.defconfig"
osource "/Users/pdlsurya/ZephyrSDK/zephyr/soc/nxp/imxrt/Kconfig.defconfig"
osource "/Users/pdlsurya/ZephyrSDK/zephyr/soc/nxp/imx/Kconfig.defconfig"
osource "/Users/pdlsurya/ZephyrSDK/zephyr/soc/nuvoton/numicro/Kconfig.defconfig"
osource "/Users/pdlsurya/ZephyrSDK/zephyr/soc/nuvoton/numaker/Kconfig.defconfig"
osource "/Users/pdlsurya/ZephyrSDK/zephyr/soc/nuvoton/npcx/Kconfig.defconfig"
osource "/Users/pdlsurya/ZephyrSDK/zephyr/soc/nordic/Kconfig.defconfig"
osource "/Users/pdlsurya/ZephyrSDK/zephyr/soc/neorv32/Kconfig.defconfig"
osource "/Users/pdlsurya/ZephyrSDK/zephyr/soc/native/inf_clock/Kconfig.defconfig"
osource "/Users/pdlsurya/ZephyrSDK/zephyr/soc/microchip/miv/Kconfig.defconfig"
osource "/Users/pdlsurya/ZephyrSDK/zephyr/soc/microchip/mec/Kconfig.defconfig"
osource "/Users/pdlsurya/ZephyrSDK/zephyr/soc/lowrisc/opentitan/Kconfig.defconfig"
osource "/Users/pdlsurya/ZephyrSDK/zephyr/soc/litex/litex_vexriscv/Kconfig.defconfig"
osource "/Users/pdlsurya/ZephyrSDK/zephyr/soc/ite/ec/Kconfig.defconfig"
osource "/Users/pdlsurya/ZephyrSDK/zephyr/soc/intel/raptor_lake/Kconfig.defconfig"
osource "/Users/pdlsurya/ZephyrSDK/zephyr/soc/intel/lakemont/Kconfig.defconfig"
osource "/Users/pdlsurya/ZephyrSDK/zephyr/soc/intel/intel_socfpga_std/Kconfig.defconfig"
osource "/Users/pdlsurya/ZephyrSDK/zephyr/soc/intel/intel_socfpga/Kconfig.defconfig"
osource "/Users/pdlsurya/ZephyrSDK/zephyr/soc/intel/intel_niosv/Kconfig.defconfig"
osource "/Users/pdlsurya/ZephyrSDK/zephyr/soc/intel/intel_ish/Kconfig.defconfig"
osource "/Users/pdlsurya/ZephyrSDK/zephyr/soc/intel/intel_adsp/Kconfig.defconfig"
osource "/Users/pdlsurya/ZephyrSDK/zephyr/soc/intel/elkhart_lake/Kconfig.defconfig"
osource "/Users/pdlsurya/ZephyrSDK/zephyr/soc/intel/atom/Kconfig.defconfig"
osource "/Users/pdlsurya/ZephyrSDK/zephyr/soc/intel/apollo_lake/Kconfig.defconfig"
osource "/Users/pdlsurya/ZephyrSDK/zephyr/soc/intel/alder_lake/Kconfig.defconfig"
osource "/Users/pdlsurya/ZephyrSDK/zephyr/soc/infineon/xmc/Kconfig.defconfig"
osource "/Users/pdlsurya/ZephyrSDK/zephyr/soc/gd/gd32/Kconfig.defconfig"
osource "/Users/pdlsurya/ZephyrSDK/zephyr/soc/gaisler/leon3/Kconfig.defconfig"
osource "/Users/pdlsurya/ZephyrSDK/zephyr/soc/gaisler/gr716a/Kconfig.defconfig"
osource "/Users/pdlsurya/ZephyrSDK/zephyr/soc/espressif/Kconfig.defconfig"
osource "/Users/pdlsurya/ZephyrSDK/zephyr/soc/ene/kb1200/Kconfig.defconfig"
osource "/Users/pdlsurya/ZephyrSDK/zephyr/soc/efinix/sapphire/Kconfig.defconfig"
osource "/Users/pdlsurya/ZephyrSDK/zephyr/soc/cypress/Kconfig.defconfig"
osource "/Users/pdlsurya/ZephyrSDK/zephyr/soc/cdns/xtensa_sample_controller/Kconfig.defconfig"
osource "/Users/pdlsurya/ZephyrSDK/zephyr/soc/cdns/dc233c/Kconfig.defconfig"
osource "/Users/pdlsurya/ZephyrSDK/zephyr/soc/brcm/bcmvk/Kconfig.defconfig"
osource "/Users/pdlsurya/ZephyrSDK/zephyr/soc/brcm/bcm2711/Kconfig.defconfig"
osource "/Users/pdlsurya/ZephyrSDK/zephyr/soc/atmel/sam0/Kconfig.defconfig"
osource "/Users/pdlsurya/ZephyrSDK/zephyr/soc/atmel/sam/Kconfig.defconfig"
osource "/Users/pdlsurya/ZephyrSDK/zephyr/soc/aspeed/Kconfig.defconfig"
osource "/Users/pdlsurya/ZephyrSDK/zephyr/soc/arm/Kconfig.defconfig"
osource "/Users/pdlsurya/ZephyrSDK/zephyr/soc/arm/beetle/Kconfig.defconfig"
osource "/Users/pdlsurya/ZephyrSDK/zephyr/soc/andestech/Kconfig.defconfig"
osource "/Users/pdlsurya/ZephyrSDK/zephyr/soc/ambiq/Kconfig.defconfig"
osource "/Users/pdlsurya/ZephyrSDK/zephyr/soc/altr/zephyr_nios2f/Kconfig.defconfig"
osource "/Users/pdlsurya/ZephyrSDK/zephyr/soc/altr/qemu_nios2/Kconfig.defconfig"
```
